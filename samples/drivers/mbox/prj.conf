## CMakeLists.txt
```
#
# Copyright (c) 2021 Carlo Caione <ccaione@baylibre.com>
# Copyright 2023-2025 NXP
# Copyright 2025 Ezurio LLC
#
# SPDX-License-Identifier: Apache-2.0
#

cmake_minimum_required(VERSION 3.20.0)

find_package(Zephyr REQUIRED HINTS $ENV{ZEPHYR_BASE})

set(REMOTE_ZEPHYR_DIR ${CMAKE_CURRENT_BINARY_DIR}/../remote/zephyr)

if(CONFIG_BOARD_NRF5340DK_NRF5340_CPUAPP OR
   CONFIG_BOARD_NRF5340BSIM_NRF5340_CPUAPP OR
   CONFIG_BOARD_ADP_XC7K_AE350 OR
   CONFIG_BOARD_MIMXRT1170_EVK_MIMXRT1176_CM7 OR
   CONFIG_BOARD_MIMXRT1160_EVK_MIMXRT1166_CM7 OR
   CONFIG_BOARD_MIMXRT1180_EVK_MIMXRT1189_CM33 OR
   CONFIG_BOARD_LPCXPRESSO55S69_LPC55S69_CPU0 OR
   CONFIG_BOARD_FRDM_MCXN947_MCXN947_CPU0 OR
   CONFIG_BOARD_MCX_N9XX_EVK_MCXN947_CPU0 OR
   CONFIG_BOARD_ESP32_DEVKITC_ESP32_PROCPU OR
   CONFIG_BOARD_ESP32S3_DEVKITM_ESP32S3_PROCPU OR
   CONFIG_BOARD_ESP32C6_DEVKITC_ESP32C6_HPCORE OR
   CONFIG_BOARD_NRF54H20DK_NRF54H20_CPUAPP OR
   CONFIG_BOARD_NRF54L15DK_NRF54L15_CPUAPP OR
   CONFIG_BOARD_NRF54LM20DK_NRF54LM20A_CPUAPP OR
   CONFIG_BOARD_STM32H747I_DISCO_STM32H747XX_M7 OR
   CONFIG_BOARD_BL54L15_DVK_NRF54L15_CPUAPP OR
   CONFIG_BOARD_BL54L15U_DVK_NRF54L15_CPUAPP)
  message(STATUS "${BOARD}${BOARD_QUALIFIERS} compile as Main in this sample")
else()
  message(FATAL_ERROR "${BOARD}${BOARD_QUALIFIERS} is not supported for this sample")
endif()

project(mbox_ipc)

enable_language(C ASM)

if(CONFIG_INCLUDE_REMOTE_DIR)
  target_include_directories(zephyr_interface
    INTERFACE ${REMOTE_ZEPHYR_DIR}/include/public)
endif()

if("${BOARD}" STREQUAL "esp32_devkitc_procpu" OR "${BOARD}" STREQUAL "esp32s3_devkitm_procpu")
  set_source_files_properties(${REMOTE_ZEPHYR_DIR}/esp32_appcpu_firmware.c PROPERTIES GENERATED TRUE)
  target_sources(app PRIVATE src/main.c ${REMOTE_ZEPHYR_DIR}/esp32_appcpu_firmware.c)
else()
  target_sources(app PRIVATE src/main.cpp)
endif()
```

## prj.conf
```kconfig
CONFIG_PRINTK=y
CONFIG_MBOX=y

CONFIG_CPP=y
CONFIG_REQUIRES_FULL_LIBCPP=y
```

## src/main.cpp
```c
/*
 * Copyright (c) 2021 Carlo Caione <ccaione@baylibre.com>
 *
 * SPDX-License-Identifier: Apache-2.0
 */

#include <zephyr/kernel.h>
#include <zephyr/drivers/mbox.h>
#include <zephyr/sys/printk.h>

#include "cpplib.hpp"

#ifdef CONFIG_RX_ENABLED
static void callback(const struct device *dev, mbox_channel_id_t channel_id,
		     void *user_data, struct mbox_msg *data)
{
	printk("Pong (on channel %d)\n", channel_id);
}
#endif /* CONFIG_RX_ENABLED */

int main(void)
{
	int ret;

	printk("Hello from HOST - %s\n", CONFIG_BOARD_TARGET);

	printk("Value: %d\n", get_value());
	while (true) {k_sleep(K_SECONDS(1));}

#ifdef CONFIG_RX_ENABLED
	const struct mbox_dt_spec rx_channel = MBOX_DT_SPEC_GET(DT_PATH(mbox_consumer), rx);

	printk("Maximum RX channels: %d\n", mbox_max_channels_get_dt(&rx_channel));

	ret = mbox_register_callback_dt(&rx_channel, callback, NULL);
	if (ret < 0) {
		printk("Could not register callback (%d)\n", ret);
		return 0;
	}

	ret = mbox_set_enabled_dt(&rx_channel, true);
	if (ret < 0) {
		printk("Could not enable RX channel %d (%d)\n", rx_channel.channel_id, ret);
		return 0;
	}
#endif /* CONFIG_RX_ENABLED */

#ifdef CONFIG_TX_ENABLED
	const struct mbox_dt_spec tx_channel = MBOX_DT_SPEC_GET(DT_PATH(mbox_consumer), tx);

	printk("Maximum bytes of data in the TX message: %d\n", mbox_mtu_get_dt(&tx_channel));
	printk("Maximum TX channels: %d\n", mbox_max_channels_get_dt(&tx_channel));

	while (1) {
#if defined(CONFIG_MULTITHREADING)
		k_sleep(K_MSEC(2000));
#else
		k_busy_wait(2000000);
#endif

		printk("Ping (on channel %d)\n", tx_channel.channel_id);

		ret = mbox_send_dt(&tx_channel, NULL);
		if (ret < 0) {
			printk("Could not send (%d)\n", ret);
			return 0;
		}
	}
#endif /* CONFIG_TX_ENABLED */
	return 0;
}
```
