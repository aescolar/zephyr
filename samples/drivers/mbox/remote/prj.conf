## CMakeLists.txt
```
#
# Copyright (c) 2021 Carlo Caione <ccaione@baylibre.com>
# Copyright 2023-2025 NXP
# Copyright 2025 Ezurio LLC
#
# SPDX-License-Identifier: Apache-2.0
#

cmake_minimum_required(VERSION 3.20.0)

find_package(Zephyr REQUIRED HINTS $ENV{ZEPHYR_BASE})

if(CONFIG_BOARD_NRF5340DK_NRF5340_CPUNET OR
   CONFIG_BOARD_NRF5340BSIM_NRF5340_CPUNET OR
   CONFIG_BOARD_ADP_XC7K_AE350 OR
   CONFIG_BOARD_MIMXRT1170_EVK_MIMXRT1176_CM4 OR
   CONFIG_BOARD_MIMXRT1160_EVK_MIMXRT1166_CM4 OR
   CONFIG_BOARD_MIMXRT1180_EVK_MIMXRT1189_CM7 OR
   CONFIG_BOARD_LPCXPRESSO55S69_LPC55S69_CPU1 OR
   CONFIG_BOARD_FRDM_MCXN947_MCXN947_CPU1 OR
   CONFIG_BOARD_MCX_N9XX_EVK_MCXN947_CPU1 OR
   CONFIG_BOARD_ESP32_DEVKITC_ESP32_APPCPU OR
   CONFIG_BOARD_ESP32S3_DEVKITM_ESP32S3_APPCPU OR
   CONFIG_BOARD_ESP32C6_DEVKITC_ESP32C6_LPCORE OR
   CONFIG_BOARD_NRF54H20DK_NRF54H20_CPUPPR OR
   CONFIG_BOARD_NRF54H20DK_NRF54H20_CPUFLPR OR
   CONFIG_BOARD_NRF54H20DK_NRF54H20_CPURAD OR
   CONFIG_BOARD_NRF54L15DK_NRF54L15_CPUFLPR OR
   CONFIG_BOARD_NRF54LM20DK_NRF54LM20A_CPUFLPR OR
   CONFIG_BOARD_STM32H747I_DISCO_STM32H747XX_M4 OR
   CONFIG_BOARD_BL54L15_DVK_NRF54L15_CPUFLPR OR
   CONFIG_BOARD_BL54L15U_DVK_NRF54L15_CPUFLPR)
  message(STATUS "${BOARD}${BOARD_QUALIFIERS} compile as remote in this sample")
else()
  message(FATAL_ERROR "${BOARD}${BOARD_QUALIFIERS} is not supported for this sample")
endif()

project(mbox_ipc_remote)

target_sources(app PRIVATE src/main.cpp)
```

## prj.conf
```kconfig
CONFIG_STDOUT_CONSOLE=n
CONFIG_MBOX=y

CONFIG_CPP=y
CONFIG_REQUIRES_FULL_LIBCPP=y
```

## src/main.cpp
```c
/*
 * Copyright (c) 2021 Carlo Caione <ccaione@baylibre.com>
 *
 * SPDX-License-Identifier: Apache-2.0
 */

#include <zephyr/kernel.h>
#include <zephyr/drivers/mbox.h>
#include <zephyr/sys/printk.h>

#include "cpplib.hpp"

#if !defined(CONFIG_RX_ENABLED) && !defined(CONFIG_TX_ENABLED)
#error "At least one of CONFIG_RX_ENABLED or CONFIG_TX_ENABLED must be set"
#endif

#ifdef CONFIG_RX_ENABLED
static void callback(const struct device *dev, mbox_channel_id_t channel_id,
		     void *user_data, struct mbox_msg *data)
{
	printk("Pong (on channel %d)\n", channel_id);
}
#endif /* CONFIG_RX_ENABLED */

int main(void)
{
	int ret;

	printk("Hello from REMOTE - %s\n", CONFIG_BOARD_TARGET);

	printk("Value: %d\n", get_value());
	while (true) {k_sleep(K_SECONDS(1));}

#ifdef CONFIG_RX_ENABLED
	const struct mbox_dt_spec rx_channel = MBOX_DT_SPEC_GET(DT_PATH(mbox_consumer), rx);

	printk("Maximum RX channels: %d\n", mbox_max_channels_get_dt(&rx_channel));

	ret = mbox_register_callback_dt(&rx_channel, callback, NULL);
	if (ret < 0) {
		printk("Could not register callback (%d)\n", ret);
		return 0;
	}

	ret = mbox_set_enabled_dt(&rx_channel, true);
	if (ret < 0) {
		printk("Could not enable RX channel %d (%d)\n", rx_channel.channel_id, ret);
		return 0;
	}
#endif /* CONFIG_RX_ENABLED */

#ifdef CONFIG_TX_ENABLED
	const struct mbox_dt_spec tx_channel = MBOX_DT_SPEC_GET(DT_PATH(mbox_consumer), tx);

	printk("Maximum bytes of data in the TX message: %d\n", mbox_mtu_get_dt(&tx_channel));
	printk("Maximum TX channels: %d\n", mbox_max_channels_get_dt(&tx_channel));

	while (1) {
#if defined(CONFIG_MULTITHREADING)
		k_sleep(K_MSEC(3000));
#else
		k_busy_wait(3000000);
#endif

		printk("Ping (on channel %d)\n", tx_channel.channel_id);

		ret = mbox_send_dt(&tx_channel, NULL);
		if (ret < 0) {
			printk("Could not send (%d)\n", ret);
			return 0;
		}
	}
#endif /* CONFIG_TX_ENABLED */
	return 0;
}
```
