## arch/posix/Kconfig.natsim_optional
```kconfig
# Copyright (c) 2025 Nordic Semiconductor ASA
# SPDX-License-Identifier: Apache-2.0

config NATIVE_USE_NSI_ERRNO
	bool
	help
	  Build the native simulator nsi_errno component with the Zephyr embedded code.
	  This component allows translating errno values from/to the embedded libC to/from the host libC.

config NATIVE_USE_NSI_FCNTL
	bool
	help
	  Build the native simulator nsi_fcntl component with the Zephyr embedded code.
	  This component allows translating fcntl values (e.g. open() flags) from/to the embedded
	  libC to/from the host libC.
```

## tests/bsim/bluetooth/ll/edtt/gatt_test_app/testcase.yaml
```yaml
common:
  tags:
    - bluetooth
  platform_allow:
    - nrf52_bsim/native
    - nrf5340bsim/nrf5340/cpunet
    - nrf54l15bsim/nrf54l15/cpuapp
  integration_platforms:
    - nrf52_bsim/native
  harness: bsim
tests:
  bluetooth.ll.edtt.gatt_test_app:
    harness_config:
      bsim_exe_name: tests_bsim_bluetooth_ll_edtt_gatt_test_app_prj_llcp_conf
      tests_scripts:
        - ../tests_scripts/gatt.llcp.sh
    extra_args:
      CONF_FILE=prj_llcp.conf
    required_applications:
      - name: bluetooth.ll.edtt.hci_test_app.dut
```

## tests/bsim/bluetooth/ll/edtt/hci_test_app/testcase.yaml
```yaml
common:
  tags:
    - bluetooth
  platform_allow:
    - nrf52_bsim/native
    - nrf5340bsim/nrf5340/cpunet
    - nrf54l15bsim/nrf54l15/cpuapp
  integration_platforms:
    - nrf52_bsim/native
  harness: bsim
tests:
  bluetooth.ll.edtt.hci_test_app.dut:
    build_only: true
    harness_config:
      bsim_exe_name: tests_bsim_bluetooth_ll_edtt_hci_test_app_prj_dut_llcp_conf
    extra_args:
      CONF_FILE=prj_dut_llcp.conf
  bluetooth.ll.edtt.hci_test_app.tst:
    harness_config:
      bsim_exe_name: tests_bsim_bluetooth_ll_edtt_hci_test_app_prj_tst_llcp_conf
      tests_scripts:
        - ../tests_scripts/gap.llcp.sh
        - ../tests_scripts/hci.llcp.sh
        - ../tests_scripts/ll.1.llcp.sh
        - ../tests_scripts/ll.2.llcp.sh
    extra_args:
      CONF_FILE=prj_tst_llcp.conf
    required_applications:
      - name: bluetooth.ll.edtt.hci_test_app.dut
```

## tests/lib/heap_asan/testcase.yaml
```yaml
tests:
  libraries.heap_asan:
    tags: heap asan
    filter: >
      (CONFIG_RISCV or CONFIG_ARM or CONFIG_ARM64 or CONFIG_X86 or
       CONFIG_MIPS or CONFIG_XTENSA or CONFIG_SPARC or CONFIG_ARCH_POSIX)
    platform_exclude:
      - qemu_cortex_m0/nrf51822
    integration_platforms:
      - qemu_riscv32
      - qemu_cortex_m3
      - qemu_cortex_a53
      - qemu_x86_64
      - native_sim
    extra_configs:
      - arch:posix:CONFIG_PICOLIBC=y
      # To also test the embedded malloc()
```
