## boards/posix/natsim_sc/Kconfig
```kconfig
# SPDX-License-Identifier: Apache-2.0

config BOARD_NATSIM_SC
	bool "boardy"
	select POSIX_ARCH_CONSOLE
	select NATIVE_LIBRARY	
	select NATIVE_POSIX_TIMER
	imply BOARD_NATIVE_POSIX if NATSIM_NATIVE_POSIX_COMPAT

if BOARD_NATSIM_SC

comment "Native Simular (Single Core) options"

config NATSIM_NATIVE_POSIX_COMPAT
 	bool "Pretend to be a native_posix board from Kconfig point of view"
	default y
	help
	  When this option is set the natsim board will pretend to be
	  a native_posix board from kconfig point of view, to allow using it directly with
	  code which was meant for the native_posix board and checks for the macro
	  CONFIG_BOARD_NATIVE_POSIX, or requires other kconfig options which depend on it.

config NATSIM_SLOWDOWN_TO_REAL_TIME
	bool "Slow down execution to real time"
	default n if ARCH_POSIX_LIBFUZZER
	default y if BT_USERCHAN || !TEST
	help
	  When selected the execution of the process will be slowed down to real time.
	  (if there is a lot of load it may be slower than real time)
	  If deselected, the process will run as fast as possible.
	  Note that this only decouples simulated time from real/wall time. In either
	  case the zephyr kernel and application cannot tell the difference unless they
	  interact with some other driver/device which runs at real time.

config NATIVE_POSIX_SLOWDOWN_TO_REAL_TIME
	bool "Slow down execution to real time"
	select NATSIM_SLOWDOWN_TO_REAL_TIME
	help
	  Transitional option which allows applications which targetted native_posix
	  to set the correct natsim option (CONFIG_NATSIM_SLOWDOWN_TO_REAL_TIME)

# These options definition exists only to enable NATSIM_NATIVE_POSIX_COMPAT
config BOARD_NATIVE_POSIX
	bool

config BOARD_NATIVE_POSIX_32BIT
	bool

config BOARD_NATIVE_POSIX_64BIT
	bool

source "boards/$(ARCH)/common/sdl/Kconfig"

endif # BOARD_NATSIM_SC
```

## boards/posix/natsim_sc/Kconfig.board
```kconfig
# SPDX-License-Identifier: Apache-2.0

config BOARD_NATSIM_SC_32BIT
	bool "Native simulation, 32-bit mode"
	select BOARD_NATSIM_SC
	help
	  Will produce a console Linux process which can be executed natively
	  as a 32-bit executable.

config BOARD_NATSIM_SC_64BIT
	bool "Native simulation, 64-bit mode"
	select BOARD_NATSIM_SC
	select 64BIT
	help
	  Will produce a console Linux process which can be executed natively
	  as a 64-bit executable.
```

## dts/bindings/timer/nordic,nrf-timer.yaml
```yaml
# Copyright (c) 2018 Nordic Semiconductor ASA
# SPDX-License-Identifier: Apache-2.0

description: Nordic nRF timer node

compatible: "nordic,nrf-timer"

include: base.yaml

properties:
  reg:
    required: true

  cc-num:
    type: int
    required: true
    description: Number of capture/compare (CC) registers available

  max-bit-width:
    type: int
    required: true
    description: Maximum bit width supported

  interrupts:
    required: true

  prescaler:
    type: int
    required: true
    description: Prescaler value determines frequency (base_frequency/2^prescaler)

  zli:
    type: boolean
    description: Enable event handler in the ZLI (Zero latency interrupt) context

  instance:
    type: string
    required: true
    description: |
      The TIMER instance id as used in the MDK and documentation. For example for TIMER2:

        instance = "2";

      And for TIMER00:

        instance = "00";
```

## samples/net/sockets/echo_server/boards/nrf52_bsim.conf
```kconfig
# The nrf52 HW models do not have a flash model yet. Even though it is possible to use different
# replacements, the easiest one is to disable the flash, so when configured with openthread
# it will use the OPENTHREAD_SETTINGS_RAM
CONFIG_FLASH=n

#Use the open source driver:
#CONFIG_NRF_802154_SOURCE_HAL_NORDIC=y
#Build from source:
CONFIG_NRF_802154_SOURCE_INTERNAL=y

#For some reason sdk-nrf defaults this to yes unlike vanilla Zephyr
CONFIG_OPENTHREAD_MANUAL_START=n

#CONFIG_LOG_MAX_LEVEL=3 
#CONFIG_OPENTHREAD_DEBUG=y 
#CONFIG_OPENTHREAD_LOG_LEVEL_INFO=y
#CONFIG_NRF_802154_ENCRYPTION=n
```

## samples/net/wifi/boards/cc3220sf_launchxl.conf
```kconfig
# Conf file to test the net_wifi shell module with the cc3220sf WiFi driver
# cmake .. -DBOARD=cc3220sf_launchxl
CONFIG_WIFI_SIMPLELINK=y
CONFIG_NEWLIB_LIBC=y
# Debugging
CONFIG_WIFI_LOG_LEVEL_DBG=y
CONFIG_DEBUG=y
```

## soc/posix/inf_clock/Kconfig
```kconfig
# Copyright (c) 2023 Nordic Semiconductor ASA
# SPDX-License-Identifier: Apache-2.0

config NATIVE_SIMULATOR_MCU_N
	int "CPU Number this image targets"
	range 0 15
	default 0
	depends on NATIVE_LIBRARY
	help
	  Which native simulator microcontroller/CPU number is this image targeting.
	  This option is only applicable for targets which use the
	  native simulator as their runner.
```
